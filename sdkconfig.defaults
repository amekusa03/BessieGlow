## sdkconfig.defaults
```kconfig
CONFIG_IDF_TARGET="esp32c6"

# Wi-Fi SoftAP
CONFIG_ESP_WIFI_SOFTAP_SUPPORT=y

# FreeRTOS
CONFIG_FREERTOS_HZ=1000

# HTTP Server
CONFIG_HTTPD_MAX_REQ_HDR_LEN=1024
CONFIG_HTTPD_MAX_URI_LEN=512
CONFIG_HTTPD_ERR_RESP_NO_DELAY=y

# NVS
CONFIG_NVS_ASSERT_ERROR_CHECK=y
```
